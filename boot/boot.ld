OUTPUT_ARCH(riscv)
ENTRY(_start)
SECTIONS {
    . = 0x1000;

    .text : {
        *(.text)
    }

    .rodata : {
        *(.rodata)
    }

    .data : {
        *(.data)
    }

    .bss : {
        *(.bss)
    }

    _end = .;
}
